## components/tinybft/Kconfig
```kconfig
menu "TinyBFT Configuration"

config TINYBFT_ENABLED
    bool "Enable TinyBFT"
    default y
    help
        Enable TinyBFT BFT consensus library.

if TINYBFT_ENABLED

choice TINYBFT_TRANSPORT_CHOICE
    prompt "Transport layer"
    default TINYBFT_TRANSPORT_ESPNOW
    help
        Select the transport layer for communication between replicas.

    config TINYBFT_TRANSPORT_UDP
        bool "UDP"
        help
            Use UDP over WiFi. Requires WiFi connection to AP.
            Suitable for standard networking.

    config TINYBFT_TRANSPORT_ESPNOW
        bool "ESP-NOW"
        help
            Use ESP-NOW for direct device-to-device communication.
            Lower latency, no WiFi AP required. Best for embedded.

endchoice

# Set compile definition based on choice
config TINYBFT_TRANSPORT
    string
    default "UDP" if TINYBFT_TRANSPORT_UDP
    default "ESP_NOW" if TINYBFT_TRANSPORT_ESPNOW

config TINYBFT_MAX_MESSAGE_SIZE
    int "Maximum message size"
    default 8192
    range 1024 16384
    help
        Maximum size of messages in bytes.
        For ESP-NOW, this is limited by the MTU (1470 bytes).
        Messages larger than MTU will be fragmented.

config TINYBFT_NUM_REPLICAS
    int "Number of replicas"
    default 7
    range 4 19
    help
        Number of replicas in the BFT cluster.
        With n replicas, can tolerate f = (n-1)/3 faulty nodes.

config TINYBFT_MAX_NUM_CLIENTS
    int "Maximum number of clients"
    default 1
    range 1 10
    help
        Maximum number of clients supported.

config TINYBFT_WINDOW_SIZE
    int "Window size"
    default 128
    range 32 256
    help
        Number of sequence numbers accepted during a certain time.

config TINYBFT_CHECKPOINT_INTERVAL
    int "Checkpoint interval"
    default 128
    range 16 256
    help
        Interval between checkpoints.

config TINYBFT_FRAG_TIMEOUT_MS
    int "Fragment reassembly timeout (ms)"
    default 5000
    range 1000 30000
    help
        Timeout in milliseconds for fragment reassembly.
        If all fragments are not received within this time,
        the partial message is dropped.

config TINYBFT_WIFI_CHANNEL
    int "WiFi channel for ESP-NOW"
    default 6
    range 1 14
    help
        WiFi channel to use for ESP-NOW communication.
        All nodes must use the same channel.

endif

endmenu
```

## sdkconfig.defaults
```kconfig
CONFIG_TINYBFT_ENABLED=y
CONFIG_TINYBFT_TRANSPORT_ESPNOW=y
CONFIG_TINYBFT_TRANSPORT="ESP_NOW"
CONFIG_TINYBFT_MAX_MESSAGE_SIZE=8192
CONFIG_TINYBFT_NUM_REPLICAS=7
CONFIG_TINYBFT_MAX_NUM_CLIENTS=1
CONFIG_TINYBFT_WINDOW_SIZE=128
CONFIG_TINYBFT_CHECKPOINT_INTERVAL=128
CONFIG_TINYBFT_FRAG_TIMEOUT_MS=5000
CONFIG_TINYBFT_WIFI_CHANNEL=6

CONFIG_ESPTOOLPY_FLASHSIZE_4MB=y
CONFIG_ESPTOOLPY_FLASHSIZE="4MB"
CONFIG_PARTITION_TABLE_SINGLE_APP=y

CONFIG_FREERTOS_HZ=1000
CONFIG_ESP_SYSTEM_EVENT_QUEUE_SIZE=32
CONFIG_ESP_SYSTEM_EVENT_TASK_STACK_SIZE=4096

# Route console to USB Serial JTAG instead of UART0
CONFIG_ESP_CONSOLE_USB_SERIAL_JTAG=y
CONFIG_ESP_CONSOLE_SECONDARY_NONE=y
```
